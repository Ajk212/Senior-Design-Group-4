#include <stdio.h>
#include <string.h>
#include "freertos/FreeRTOS.h"
#include "freertos/task.h"
#include "driver/i2c.h"
#include "esp_log.h"

#include "oled.h"

static const char *OLEDTAG = "OLED";

// I2C Configuration
#define I2C_MASTER_NUM I2C_NUM_0

static void oled_write_command(uint8_t command)
{
    uint8_t buf[2] = {0x00, command};
    i2c_master_write_to_device(I2C_MASTER_NUM, OLED_ADDRESS, buf, 2, pdMS_TO_TICKS(1000));
}

static void oled_write_data(uint8_t data)
{
    uint8_t buf[2] = {0x40, data};
    i2c_master_write_to_device(I2C_MASTER_NUM, OLED_ADDRESS, buf, 2, pdMS_TO_TICKS(1000));
}

void oled_clear_screen(void)
{
    for (int page = 0; page < 8; page++)
    {
        oled_write_command(0xB0 + page);
        oled_write_command(0x00);
        oled_write_command(0x10);
        for (int col = 0; col < 128; col++)
        {
            oled_write_data(0x00);
        }
    }
}

void oled_set_cursor(uint8_t page, uint8_t column)
{
    oled_write_command(0xB0 + page);
    oled_write_command(0x00 + (column & 0x0F));
    oled_write_command(0x10 + ((column >> 4) & 0x0F));
}

// Simple font data for basic characters (0-9, A-Z, a-z, space, and some symbols)
static const uint8_t simple_font[95][5] = {
    {0x00, 0x00, 0x00, 0x00, 0x00}, // space
    {0x00, 0x00, 0x5F, 0x00, 0x00}, // !
    {0x00, 0x07, 0x00, 0x07, 0x00}, // "
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    {0x10, 0x08, 0x08, 0x10, 0x08}, // ~
};

void oled_write_char(char c)
{
    if (c < 32 || c > 126)
        return; // Only printable ASCII characters

    const uint8_t *char_data = simple_font[c - 32];
    for (int i = 0; i < 5; i++)
    {
        oled_write_data(char_data[i]);
    }
    oled_write_data(0x00); // Space between characters
}

void oled_print_text(uint8_t page, uint8_t column, const char *text)
{
    oled_set_cursor(page, column);

    // Print at most 20 characters
    int i;
    for (i = 0; i < 20 && text[i] != '\0'; i++)
    {
        oled_write_char(text[i]);
    }

    // Pad with spaces if shorter than 20
    while (i < 20)
    {
        oled_write_char(' ');
        i++;
    }
}

void oled_print_text_simple(uint8_t page, uint8_t column, const char *text)
{
    oled_set_cursor(page, column);

    for (int i = 0; text[i] != '\0'; i++)
    {
        oled_write_char(text[i]);
    }
}

void oled_init_simple(void)
{
    ESP_LOGI(OLEDTAG, "Initializing OLED display...");

    vTaskDelay(pdMS_TO_TICKS(100));

    // SSD1306 initialization sequence
    oled_write_command(0xAE); // Display OFF
    oled_write_command(0x20); // Memory addressing mode
    oled_write_command(0x00); // Horizontal addressing mode
    oled_write_command(0x21); // Column address
    oled_write_command(0x00); // Start column 0
    oled_write_command(0x7F); // End column 127
    oled_write_command(0x22); // Page address
    oled_write_command(0x00); // Start page 0
    oled_write_command(0x07); // End page 7
    oled_write_command(0x40); // Start line 0
    oled_write_command(0xA0); // Segment remap
    oled_write_command(0xA8); // Multiplex ratio
    oled_write_command(0x3F); // 64MUX
    oled_write_command(0xC0); // COM scan normal
    oled_write_command(0xA4); // Entire display ON
    oled_write_command(0xA6); // Normal display
    oled_write_command(0xD3); // Display offset
    oled_write_command(0x00); // No offset
    oled_write_command(0xD5); // Display clock divide
    oled_write_command(0x80); // Default
    oled_write_command(0xD9); // Pre-charge period
    oled_write_command(0xF1);
    oled_write_command(0xDA); // COM pins hardware configuration
    oled_write_command(0x12);
    oled_write_command(0xDB); // VCOMH deselect level
    oled_write_command(0x40);
    oled_write_command(0x8D); // Charge pump setting
    oled_write_command(0x14); // Enable charge pump
    oled_write_command(0xAF); // Display ON

    oled_clear_screen();
    ESP_LOGI(OLEDTAG, "OLED initialized successfully");
}

void oled_update_display(float accel1_x, float accel1_y, float accel1_z,
                         float accel2_x, float accel2_y, float accel2_z,
                         float gyro1_x, float gyro1_y, float gyro1_z,
                         float gyro2_x, float gyro2_y, float gyro2_z,
                         float temp1, float temp2)
{
    char buf[21];

    snprintf(buf, sizeof(buf), "Dual IMU Monitor");
    oled_print_text(0, 0, buf);

    snprintf(buf, sizeof(buf), "A1:%.1f,%.1f,%.1f", accel1_x, accel1_y, accel1_z);
    oled_print_text(1, 0, buf);

    snprintf(buf, sizeof(buf), "G1:%.1f,%.1f,%.1f", gyro1_x, gyro1_y, gyro1_z);
    oled_print_text(2, 0, buf);

    snprintf(buf, sizeof(buf), "A2:%.1f,%.1f,%.1f", accel2_x, accel2_y, accel2_z);
    oled_print_text(3, 0, buf);

    snprintf(buf, sizeof(buf), "G2:%.1f,%.1f,%.1f", gyro2_x, gyro2_y, gyro2_z);
    oled_print_text(4, 0, buf);

    snprintf(buf, sizeof(buf), "T1:%.1fF T2:%.1fF", temp1, temp2);
    oled_print_text(5, 0, buf);
}

// Draw bitmap with inversion option
void oled_draw_bitmap(uint8_t page, uint8_t column, const uint8_t *bitmap, uint8_t width, uint8_t height, bool invert)
{
    uint8_t pages = (height + 7) / 8;

    for (uint8_t p = 0; p < pages; p++)
    {
        oled_set_cursor(page + p, column);
        for (uint8_t w = 0; w < width; w++)
        {
            uint8_t data = bitmap[p * width + w];
            oled_write_data(invert ? ~data : data);
        }
    }
}